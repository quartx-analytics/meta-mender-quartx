## conf/layer.conf
```bitbake
# We have a conf and classes directory, add to BBPATH
BBPATH .= ":${LAYERDIR}"

# We have recipes-* directories, add to BBFILES
BBFILES += "${LAYERDIR}/recipes-*/*/*.bb \
            ${LAYERDIR}/recipes-*/*/*.bbappend"

BBFILE_COLLECTIONS += "mender-quartx"
BBFILE_PATTERN_mender-quartx = "^${LAYERDIR}/"
BBFILE_PRIORITY_mender-quartx = "10"

LAYERDEPENDS_mender-quartx = "mender openembedded-layer"
LAYERSERIES_COMPAT_mender-quartx = "dunfell"
```

## meta-quartx-calllogger/conf/layer.conf
```bitbake
# We have a conf and classes directory, add to BBPATH
BBPATH .= ":${LAYERDIR}"

# We have recipes-* directories, add to BBFILES
BBFILES += "${LAYERDIR}/recipes-*/*/*.bb \
            ${LAYERDIR}/recipes-*/*/*.bbappend"

# Layer config
BBFILE_COLLECTIONS += "quartx-calllogger"
BBFILE_PATTERN_quartx-calllogger = "^${LAYERDIR}/"
BBFILE_PRIORITY_quartx-calllogger = "6"

# Dependencies
LAYERDEPENDS_quartx-calllogger = "mender virtualization-layer"
LAYERSERIES_COMPAT_quartx-calllogger = "dunfell"

# Add Docker support
DISTRO_FEATURES_append = " virtualization"
IMAGE_INSTALL_append = " mender-connect docker-ce python3-docker-compose"
```

## meta-quartx-core/conf/layer.conf
```bitbake
# We have a conf and classes directory, add to BBPATH
BBPATH .= ":${LAYERDIR}"

# We have recipes-* directories, add to BBFILES
BBFILES += "${LAYERDIR}/recipes-*/*/*.bb \
            ${LAYERDIR}/recipes-*/*/*.bbappend"

# Layer config
BBFILE_COLLECTIONS += "quartx-core"
BBFILE_PATTERN_quartx-core = "^${LAYERDIR}/"
BBFILE_PRIORITY_quartx-core = "6"

# Dependencies
LAYERDEPENDS_quartx-core = "mender virtualization"
LAYERSERIES_COMPAT_quartx-core = "dunfell"
```
